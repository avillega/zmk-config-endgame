## config/boards/shields/endgame/Kconfig.defconfig
```kconfig
# Copyright (c) 2020 The ZMK Contributors
# and (c) 2022 tubbytwins (Matthew A. Schnoor) and beekeeb
# SPDX-License-Identifier: MIT

if SHIELD_ENDGAME

config ZMK_KEYBOARD_NAME
    default "endgame"

endif
```
